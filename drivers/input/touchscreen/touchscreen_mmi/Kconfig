## drivers/input/touchscreen/touchscreen_mmi/Kconfig
```kconfig
config TOUCHSCREEN_MMI
	tristate "Moto touchscreen gestures"
	default n
	select INPUT_TOUCHSCREEN_MMI
	help
	 Say Y here if you wish to include support for Moto touchscreen gestures.
	 If unsure, say N.

config INPUT_TOUCHSCREEN_MMI
	bool "Moto touchscreen mmi"
	depends on TOUCHSCREEN_MMI

if TOUCHSCREEN_MMI

config TOUCHCLASS_MMI_DEBUG_INFO
	bool "Moto touchscreen gestures debug info"
	default n
	help
	 Say Y here if you wish to include support for Moto touchscreen gestures debugging info.
	 If unsure, say N.

config TOUCHCLASS_MMI_GESTURE_POISON_EVENT
	bool "Moto gestures event poison"
	default n
	help
	 Say Y here if you wish to include support for Moto gestures event poison.
	 If unsure, say N.

config TOUCHCLASS_MMI_MULTIWAY_UPDATE_FW
	bool "Moto TP firmware through the Parameter APK"
	depends on TOUCHSCREEN_MMI
	default n
	help
	  Say Y here if you want to have TP firmware through the Parameter APK.
	  If unsure, say N.

config DRM_PANEL_NOTIFICATIONS
	bool "Moto DRM panel notifications"
	default n
	help
	 Say Y here if your panel includes support for drm notifications.
	 If unsure, say N.

config DRM_PANEL_EVENT_NOTIFICATIONS
	bool "Moto DRM panel event notifications"
	default n
	help
	 Say Y here if your panel includes support for drm event notifications.
	 If unsure, say N.

endif

config BOARD_USES_DOUBLE_TAP_CTRL
	bool "Board uses Double Tap Control"
```
